
//store the different sprites in PROGMEM to save RAM

//sprite 0
//const byte Eau[] PROGMEM = {16,16,0xFF,0xFF,0xFF,0xFF,0xFF,0xFD,0xF7,0xFA,0xEB,0xFF,0xFF,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0xFF,};
//const byte Eau[] PROGMEM = {16,16,0xFF,0xFF,0xFF,0xFF,0xFF,0xFF,0xF7,0xF8,0xEB,0xFF,0xFF,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0xFF,};
//const byte Eau2[] PROGMEM = {16,16,0xFF,0xFF,0xFF,0xFF,0xFF,0xFF,0xFF,0xFA,0xE3,0xFD,0xFF,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0xFF,};
const byte Eau[] PROGMEM = {16,16,0xFF,0xFF,0xFF,0xFF,0xFF,0xFF,0xFB,0xFF,0xF5,0xFF,0xCE,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0xFF,};
const byte Eau2[] PROGMEM = {16,16,0xFF,0xFF,0xFF,0xFF,0xFF,0xFF,0xFF,0xFF,0xFF,0xE3,0xFF,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0xFF,};

//sprite 1
const byte Fleure[] PROGMEM = {16,16,0x0,0x0,0x50,0x0,0x20,0x28,0x50,0x10,0x0,0x28,0x0,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0x0,};
const byte Fleure2[] PROGMEM = {16,16,0x0,0x0,0x50,0x50,0x20,0x20,0x50,0x50,0x0,0x0,0x0,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0x0,};

//sprite 2
const byte Foret[] PROGMEM = {16,16,0x0,0x0,0x10,0x0,0x6D,0x0,0x54,0x8,0xAA,0x14,0x54,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0x0,};
const byte Foret2[] PROGMEM = {16,16,0x0,0x0,0x10,0x0,0x6D,0x0,0x54,0x8,0xAA,0x14,0x54,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0x0,};

//sprite 3
const byte Pavillon[] PROGMEM = {16,16,0x0,0x8,0x0,0xA4,0x0,0x48,0x0,0x30,0x0,0x30,0x1,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0x25,};
const byte Pavillon2[] PROGMEM = {16,16,0x0,0x0,0x0,0x8,0x0,0x68,0x0,0x30,0x0,0x30,0x1,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0x25,};

//sprite 4
const byte RoofTop[] PROGMEM = {16,16,0x2,0x0,0x5,0xC0,0x8,0x30,0x10,0x8,0x21,0x4,0x44,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0x0,};
const byte RoofTop2[] PROGMEM = {16,16,0x4,0x0,0xB,0x80,0x10,0x60,0x20,0x10,0x42,0x8,0x4D,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0x0,};

//sprite 5
const byte Usine1_1[] PROGMEM = {16,16,0x0,0x0,0x0,0x0,0x0,0x0,0x0,0x0,0x55,0x55,0xAA,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0xAA,};
const byte Usine1_2[] PROGMEM = {16,16,0x0,0x0,0x0,0x0,0x0,0x0,0x0,0x0,0xAA,0xAA,0x55,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0x55,};

//sprite 6
const byte Usine2_1[] PROGMEM = {16,16,0x0,0x20,0x0,0x50,0x38,0x20,0x67,0xFE,0x55,0x82,0x4C,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0x0,};
const byte Usine2_2[] PROGMEM = {16,16,0x0,0x20,0x0,0x50,0x38,0x20,0x4F,0xFE,0x55,0x2,0x64,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0x0,};

//alternatif
const byte cactus1[] PROGMEM = {16,16,0x0,0x0,0x0,0x0,0x1,0xC0,0x2,0x20,0x5,0x10,0x4,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0xF0,};
const byte cactus2[] PROGMEM = {16,16,0x0,0x0,0x0,0x0,0x3,0xC0,0x4,0x20,0xA,0x20,0x8,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0xE0,};







const byte * GetSpriteById(byte idSprite)
{
  if(gb.frameCount%10 > 4) {
    idSprite += 7;
  }
  switch(idSprite)
  {
    case 0 :  
    return Eau;
    break;
    case 1 :
    return Fleure;
    break;
    case 2 :
    return cactus1;
    break;
    case 3 :
    return Pavillon;
    break;
    case 4 :
    return RoofTop;
    break;
    case 5 :
    return Usine2_1;
    break;
    case 6 :
    return Usine1_1;
    break;
    
    case 7 :  
    return Eau2;
    break;
    case 8 :
    return Fleure2;
    break;
    case 9 :
    return cactus2;
    break;
    case 10 :
    return Pavillon2;
    break;
    case 11 :
    return RoofTop2;
    break;
    case 12 :
    return Usine2_2;
    break;
    case 13 :
    return Usine1_2;
    break;
  }
}

#define NB_ZONE 10
//x1,y1, x2 ,y2, tuile
const byte Zones[NB_ZONE*5] PROGMEM = 
{
  19,0,118,31,3,
  56,68,64,74,0,
  0,32,32,62,0,
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  14,116,30,123,3,
};


#define WORLD_W 128
#define WORLD_H 128
const byte world[] PROGMEM = {0xFF,0xFF,0xFF,0xFF,0xFF,0xFF,0xFF,0xFF,0xFF,0xFF,0xFF,0xFF,0xFF,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0xFF,};
byte getTile(byte x, byte y){
  //le decalage dépend de la position du joueur je divise x/8 car j'ai 8 bit dans un byte. puis je décale du nombre de bit util pour ne garder que le premier
  return (pgm_read_byte(world + (y*16) + x/8) >> (7-((x%8)))& B00000001);
}

void drawWorld(){
   for(byte y = max(0, (camera_y)/16); y < min(WORLD_H, (camera_y+LCDHEIGHT)/16+1); y++){
    for(byte x = max(0, (camera_x)/16); x < min(WORLD_W, (camera_x+LCDWIDTH)/16+1); x++){
      byte spriteID = getTile(x,y);
      if(spriteID == 0)
        continue;
        
        byte numSprite = 2;
       //Verrification des zone de sprite
        for(byte i=0;i<NB_ZONE;i++)
        {
          byte decalage = 5*i;
          byte x1 = pgm_read_byte(Zones + decalage);
          byte y1 = pgm_read_byte(Zones +decalage+1);
          byte x2 = pgm_read_byte(Zones+decalage+2);
          byte y2 = pgm_read_byte(Zones+decalage+3);
          
          if(gb.collidePointRect(x,y,x1,y1,x2-x1,y2-y1))
          {
            numSprite = pgm_read_byte(Zones+decalage+4);
            break;
          }
        }
      //coordinates on the screen depending on the camera position
      int x_screen = x*16 - camera_x;
      int y_screen = y*16 - camera_y;
      gb.display.drawBitmap(x_screen, y_screen, GetSpriteById(numSprite));
    }
  }
}

void drawMiniMap(){
  
  int old_x = camera_x;
  int old_y = camera_y;
  camera_y = player.y/16;
  camera_x = player.x/16;
  byte cptFrame = 0;
  while(true)
  {
    if(gb.update())
    {
      for(byte y = camera_y; y < min(WORLD_H, camera_y+LCDHEIGHT); y++){
        for(byte x = camera_x; x < min(WORLD_W, camera_x+LCDWIDTH); x++){
          byte spriteID = getTile(x,y);
          if(spriteID == 0)
          {
            continue;
          }
          gb.display.drawPixel(x - camera_x , y-camera_y);
        }
      }
      
       gb.display.setColor(GRAY);
       if(cptFrame%20>9) {
         gb.display.drawPixel((player.x/16) - camera_x,(player.y/16) - camera_y);
         gb.display.drawCircle((player.x/16) - camera_x,(player.y/16) - camera_y, 2);
       }
       if(cptFrame%20>9){
         gb.display.drawPixel((xDest/16) - camera_x,(yDest/16) - camera_y);
         gb.display.drawCircle((xDest/16) - camera_x, (yDest/16) - camera_y , 4);
       }
       gb.display.setColor(BLACK);
        
       if(gb.buttons.repeat(BUTTON_LEFT, 1) &&  camera_x > 0)
       {
         camera_x--;
       }
       if(gb.buttons.repeat(BUTTON_RIGHT, 1)&&  camera_x < (WORLD_W-LCDWIDTH))
       {
         camera_x++;
       }
       if(gb.buttons.repeat(BUTTON_UP, 1)&&  camera_y > 0)
       {
         camera_y--;
       }
       if(gb.buttons.repeat(BUTTON_DOWN, 1)&&  camera_y < (WORLD_H-LCDHEIGHT))
       {
         camera_y++;
       }
       if(gb.buttons.pressed(BUTTON_A) || gb.buttons.pressed(BUTTON_C)||gb.buttons.pressed(BUTTON_B))
       {
         break;
       }   
       
       cptFrame++;
    }
  }
  camera_y = old_y;
  camera_x = old_x;
}



